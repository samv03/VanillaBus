VERSION "T7-mux"

NS_ :

BS_:

BU_: ECU Tester

BO_ 512 MuxStatus: 8 ECU
 SG_ MuxId M : 0|8@1+ (1,0) [0|1] "" Tester
 SG_ CoolantTemp m0 : 8|16@1+ (0.1,-40) [-40|615.35] "degC" Tester
 SG_ FuelPressure m1 : 8|16@1+ (1,0) [0|65535] "kPa" Tester
 SG_ Counter : 24|8@1+ (1,0) [0|255] "" Tester

CM_ "VanillaBus T7 basic multiplex fixture: MuxId selects CoolantTemp (m0) or FuelPressure (m1).";
CM_ BO_ 512 "Mux selector plus one multiplexed payload and a shared counter";
